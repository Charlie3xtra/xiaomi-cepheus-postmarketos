/dts-v1/;
/plugin/;
/ {
	fragment@0 {
		target-path = "/soc@0/geniqup@ac0000/serial@a84000";
		__overlay__ {
			status = "disabled";
			bluetooth { status = "disabled"; };
		};
	};
	fragment@1 {
		target-path = "/soc@0/geniqup@cc0000/serial@c8c000";
		__overlay__ {
			status = "okay";
			bluetooth {
				compatible = "qcom,wcn3990-bt";
				vddio-supply = <0x44>;
				vddxo-supply = <0x45>;
				vddrf-supply = <0x46>;
				vddch0-supply = <0x47>;
				max-speed = <3200000>;
			};
		};
	};
};
